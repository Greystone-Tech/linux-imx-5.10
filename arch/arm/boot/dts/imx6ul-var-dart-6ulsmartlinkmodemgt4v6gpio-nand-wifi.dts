/*
 * Copyright (C) 2016-2019 Variscite Ltd. - https://www.variscite.com
 *
 * This program is free software; you can redistribute it and/or modify
 * it under the terms of the GNU General Public License version 2 as
 * published by the Free Software Foundation.
 */

/dts-v1/;

/* Core Include for board setup */
#include "imx6ul.dtsi"

/* add WiFi support*/
#include "imx6ul-var-dart-6ulsmartlinkgt4-wifi.dtsi"

/* imx6ul-imx6ull board definitions for smartlink */
#include "imx6ul-imx6ull-var-dart-smartlink.dtsi"

/* iomuxc_snvs */
/* #include "imx6ull-var-dart-smartlinkgt4.dtsi" */

/* Pin Include for Nand board setup */
#include "imx6ul-imx6ull-var-dart-nand.dtsi"

#include "imx6ull-var-dart-6ul-smartlinkgt4.dtsi"
#include "imx6ul-imx6ull-var-dart-6ul-smartlink-gt4v6-gpio.dtsi"
#include "imx6ul-imx6ull-var-dart-wifi.dtsi"

/ {
	model = "Variscite DART-6UL with i.MX6UL, NAND flash & WiFi support on VAR-6ULGreystone Modem GT4 v6 gpio";
	compatible = "variscite,imx6ul-var-dart", "fsl,imx6ul";
};
