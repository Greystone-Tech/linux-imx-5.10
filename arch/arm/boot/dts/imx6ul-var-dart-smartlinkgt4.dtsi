/*
 * Copyright (C) 2016-2023 Greystone Technologies (Pty) Ltd. - https://greystonetec.co.za/
 *
 * This program is free software; you can redistribute it and/or modify
 * it under the terms of the GNU General Public License version 2 as
 * published by the Free Software Foundation.
 */
 
 
 &iomuxc {
	pinctrl-names = "default";
	pinctrl-0 = <&pinctrl_hog>;

	pinctrl_hog: hoggrp {
		fsl,pins = <
			MX6UL_PAD_SNVS_TAMPER3__GPIO5_IO03	0x1b0b0 /* GSM POWER Active low to switch on make high J1.63 */
			MX6UL_PAD_SNVS_TAMPER8__GPIO5_IO08	0x1b0b0 /* SYSTEM LED J2.39 */
			MX6UL_PAD_SNVS_TAMPER9__GPIO5_IO09	0x1b0b0 /* SIM Select J2.49 */
			MX6UL_PAD_SNVS_TAMPER1__GPIO5_IO01	0x1b0b0 /* NO MAPPING FREE PIN external IO control J2.64 */
			MX6UL_PAD_SNVS_TAMPER7__GPIO5_IO07	0x1b0b0 /* PERST# (pen 22) can be used to reset the EC25 Used to be the RTC alarm J2.37 */
			MX6UL_PAD_SNVS_TAMPER5__GPIO5_IO05	0x1b0b0 /* CHARGE STAT 2 now BAT LED J1.51   */
		>;
	};

	pinctrl_enet1_gpio: enet1_gpiogrp {
		fsl,pins = <
			MX6UL_PAD_SNVS_TAMPER0__GPIO5_IO00	0x1b0b0 /* fec1 reset */
		>;
	};
};
