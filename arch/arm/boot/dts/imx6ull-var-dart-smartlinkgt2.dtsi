/*
 * Copyright (C) 2016-2019 Variscite Ltd. - https://www.variscite.com
 *
 * This program is free software; you can redistribute it and/or modify
 * it under the terms of the GNU General Public License version 2 as
 * published by the Free Software Foundation.
 */

&iomuxc_snvs {
	pinctrl-names = "default";
	pinctrl-0 = <&pinctrl_hog_2>;

	pinctrl_hog_2: hoggrp-2 {
		fsl,pins = <
			/* Greystone definitions */
				/* OUTPUT */
				MX6ULL_PAD_SNVS_TAMPER8__GPIO5_IO08	0x1b0b0 /* SYSTEM LED J2.39 */
				MX6ULL_PAD_SNVS_TAMPER9__GPIO5_IO09	0x1b0b0 /* SIM Select J2.49 */
				MX6ULL_PAD_SNVS_TAMPER1__GPIO5_IO01	0x1b0b0 /* GSM ON_OFF J2.64 */
				MX6ULL_PAD_SNVS_TAMPER3__GPIO5_IO03	0x1b0b0 /* GSM POWER J1.63 */
				/*MX6ULL_PAD_SNVS_TAMPER7__GPIO5_IO07	0x1b0b0 /* RTC alarm J2.37 actually wired on this version of the GT2 */
			
				/* INPUT */
				MX6ULL_PAD_SNVS_TAMPER5__GPIO5_IO05	0x17059 /* CHARGE STAT 2 J1.51   */
		>;
	};

	pinctrl_enet1_gpio: enet1_gpiogrp {
		fsl,pins = <
			MX6ULL_PAD_SNVS_TAMPER0__GPIO5_IO00	0x1b0b0 /* fec1 reset */
		>;
	};
};
